## src/kernel/linux-2.4.17_mvl21/drivers/media/Config.in
```kconfig
#
# Multimedia device configuration
#
mainmenu_option next_comment
comment 'Multimedia devices'

tristate 'Video For Linux' CONFIG_VIDEO_DEV
if [ "$CONFIG_VIDEO_DEV" != "n" ]; then
   source $TI_TARGET_KERNEL_PATH./drivers/media/video/Config.in
   source $TI_TARGET_KERNEL_PATH./drivers/media/radio/Config.in
fi

endmenu
```
